#ifndef INCLUDED_CYFITTERKEIL_INC
#define INCLUDED_CYFITTERKEIL_INC
$INCLUDE (cydevicekeil.inc)
$INCLUDE (cydevicekeil_trm.inc)

; ADC_DelSig_1_Ext_CP_Clk
ADC_DelSig_1_Ext_CP_Clk__CFG0 EQU CYREG_CLKDIST_DCFG2_CFG0
ADC_DelSig_1_Ext_CP_Clk__CFG1 EQU CYREG_CLKDIST_DCFG2_CFG1
ADC_DelSig_1_Ext_CP_Clk__CFG2 EQU CYREG_CLKDIST_DCFG2_CFG2
ADC_DelSig_1_Ext_CP_Clk__CFG2_SRC_SEL_MASK EQU 0x07
ADC_DelSig_1_Ext_CP_Clk__PM_ACT_CFG EQU CYREG_PM_ACT_CFG2
ADC_DelSig_1_Ext_CP_Clk__PM_ACT_MSK EQU 0x04
ADC_DelSig_1_Ext_CP_Clk__PM_STBY_CFG EQU CYREG_PM_STBY_CFG2
ADC_DelSig_1_Ext_CP_Clk__PM_STBY_MSK EQU 0x04

; CapSense_CompCH0_ctComp
CapSense_CompCH0_ctComp__CLK EQU CYREG_CMP2_CLK
CapSense_CompCH0_ctComp__CMP_MASK EQU 0x04
CapSense_CompCH0_ctComp__CMP_NUMBER EQU 2
CapSense_CompCH0_ctComp__CR EQU CYREG_CMP2_CR
CapSense_CompCH0_ctComp__LUT__CR EQU CYREG_LUT2_CR
CapSense_CompCH0_ctComp__LUT__MSK EQU CYREG_LUT_MSK
CapSense_CompCH0_ctComp__LUT__MSK_MASK EQU 0x04
CapSense_CompCH0_ctComp__LUT__MSK_SHIFT EQU 2
CapSense_CompCH0_ctComp__LUT__MX EQU CYREG_LUT2_MX
CapSense_CompCH0_ctComp__LUT__SR EQU CYREG_LUT_SR
CapSense_CompCH0_ctComp__LUT__SR_MASK EQU 0x04
CapSense_CompCH0_ctComp__LUT__SR_SHIFT EQU 2
CapSense_CompCH0_ctComp__PM_ACT_CFG EQU CYREG_PM_ACT_CFG7
CapSense_CompCH0_ctComp__PM_ACT_MSK EQU 0x02
CapSense_CompCH0_ctComp__PM_STBY_CFG EQU CYREG_PM_STBY_CFG7
CapSense_CompCH0_ctComp__PM_STBY_MSK EQU 0x02
CapSense_CompCH0_ctComp__SW0 EQU CYREG_CMP2_SW0
CapSense_CompCH0_ctComp__SW2 EQU CYREG_CMP2_SW2
CapSense_CompCH0_ctComp__SW3 EQU CYREG_CMP2_SW3
CapSense_CompCH0_ctComp__SW4 EQU CYREG_CMP2_SW4
CapSense_CompCH0_ctComp__SW6 EQU CYREG_CMP2_SW6
CapSense_CompCH0_ctComp__TR EQU CYREG_CMP2_TR
CapSense_CompCH0_ctComp__TRIM__TR0 EQU CYREG_FLSHID_MFG_CFG_CMP2_TR0
CapSense_CompCH0_ctComp__TRIM__TR0_HS EQU CYREG_FLSHID_CUST_TABLES_CMP2_TR0_HS
CapSense_CompCH0_ctComp__WRK EQU CYREG_CMP_WRK
CapSense_CompCH0_ctComp__WRK_MASK EQU 0x04
CapSense_CompCH0_ctComp__WRK_SHIFT EQU 2

; ADC_DelSig_1_theACLK
ADC_DelSig_1_theACLK__CFG0 EQU CYREG_CLKDIST_ACFG0_CFG0
ADC_DelSig_1_theACLK__CFG1 EQU CYREG_CLKDIST_ACFG0_CFG1
ADC_DelSig_1_theACLK__CFG2 EQU CYREG_CLKDIST_ACFG0_CFG2
ADC_DelSig_1_theACLK__CFG2_SRC_SEL_MASK EQU 0x07
ADC_DelSig_1_theACLK__CFG3 EQU CYREG_CLKDIST_ACFG0_CFG3
ADC_DelSig_1_theACLK__CFG3_PHASE_DLY_MASK EQU 0x0F
ADC_DelSig_1_theACLK__PM_ACT_CFG EQU CYREG_PM_ACT_CFG1
ADC_DelSig_1_theACLK__PM_ACT_MSK EQU 0x01
ADC_DelSig_1_theACLK__PM_STBY_CFG EQU CYREG_PM_STBY_CFG1
ADC_DelSig_1_theACLK__PM_STBY_MSK EQU 0x01

; CapSense_MeasureCH0
CapSense_MeasureCH0_UDB_Counter_u0__16BIT_A0_REG EQU CYREG_B1_UDB07_08_A0
CapSense_MeasureCH0_UDB_Counter_u0__16BIT_A1_REG EQU CYREG_B1_UDB07_08_A1
CapSense_MeasureCH0_UDB_Counter_u0__16BIT_D0_REG EQU CYREG_B1_UDB07_08_D0
CapSense_MeasureCH0_UDB_Counter_u0__16BIT_D1_REG EQU CYREG_B1_UDB07_08_D1
CapSense_MeasureCH0_UDB_Counter_u0__16BIT_DP_AUX_CTL_REG EQU CYREG_B1_UDB07_08_ACTL
CapSense_MeasureCH0_UDB_Counter_u0__16BIT_F0_REG EQU CYREG_B1_UDB07_08_F0
CapSense_MeasureCH0_UDB_Counter_u0__16BIT_F1_REG EQU CYREG_B1_UDB07_08_F1
CapSense_MeasureCH0_UDB_Counter_u0__A0_A1_REG EQU CYREG_B1_UDB07_A0_A1
CapSense_MeasureCH0_UDB_Counter_u0__A0_REG EQU CYREG_B1_UDB07_A0
CapSense_MeasureCH0_UDB_Counter_u0__A1_REG EQU CYREG_B1_UDB07_A1
CapSense_MeasureCH0_UDB_Counter_u0__D0_D1_REG EQU CYREG_B1_UDB07_D0_D1
CapSense_MeasureCH0_UDB_Counter_u0__D0_REG EQU CYREG_B1_UDB07_D0
CapSense_MeasureCH0_UDB_Counter_u0__D1_REG EQU CYREG_B1_UDB07_D1
CapSense_MeasureCH0_UDB_Counter_u0__DP_AUX_CTL_REG EQU CYREG_B1_UDB07_ACTL
CapSense_MeasureCH0_UDB_Counter_u0__F0_F1_REG EQU CYREG_B1_UDB07_F0_F1
CapSense_MeasureCH0_UDB_Counter_u0__F0_REG EQU CYREG_B1_UDB07_F0
CapSense_MeasureCH0_UDB_Counter_u0__F1_REG EQU CYREG_B1_UDB07_F1
CapSense_MeasureCH0_UDB_Window_u0__16BIT_A0_REG EQU CYREG_B0_UDB07_08_A0
CapSense_MeasureCH0_UDB_Window_u0__16BIT_A1_REG EQU CYREG_B0_UDB07_08_A1
CapSense_MeasureCH0_UDB_Window_u0__16BIT_D0_REG EQU CYREG_B0_UDB07_08_D0
CapSense_MeasureCH0_UDB_Window_u0__16BIT_D1_REG EQU CYREG_B0_UDB07_08_D1
CapSense_MeasureCH0_UDB_Window_u0__16BIT_DP_AUX_CTL_REG EQU CYREG_B0_UDB07_08_ACTL
CapSense_MeasureCH0_UDB_Window_u0__16BIT_F0_REG EQU CYREG_B0_UDB07_08_F0
CapSense_MeasureCH0_UDB_Window_u0__16BIT_F1_REG EQU CYREG_B0_UDB07_08_F1
CapSense_MeasureCH0_UDB_Window_u0__A0_A1_REG EQU CYREG_B0_UDB07_A0_A1
CapSense_MeasureCH0_UDB_Window_u0__A0_REG EQU CYREG_B0_UDB07_A0
CapSense_MeasureCH0_UDB_Window_u0__A1_REG EQU CYREG_B0_UDB07_A1
CapSense_MeasureCH0_UDB_Window_u0__D0_D1_REG EQU CYREG_B0_UDB07_D0_D1
CapSense_MeasureCH0_UDB_Window_u0__D0_REG EQU CYREG_B0_UDB07_D0
CapSense_MeasureCH0_UDB_Window_u0__D1_REG EQU CYREG_B0_UDB07_D1
CapSense_MeasureCH0_UDB_Window_u0__DP_AUX_CTL_REG EQU CYREG_B0_UDB07_ACTL
CapSense_MeasureCH0_UDB_Window_u0__F0_F1_REG EQU CYREG_B0_UDB07_F0_F1
CapSense_MeasureCH0_UDB_Window_u0__F0_REG EQU CYREG_B0_UDB07_F0
CapSense_MeasureCH0_UDB_Window_u0__F1_REG EQU CYREG_B0_UDB07_F1

; LCD_Char_1_LCDPort
LCD_Char_1_LCDPort__0__MASK EQU 0x01
LCD_Char_1_LCDPort__0__PC EQU CYREG_PRT2_PC0
LCD_Char_1_LCDPort__0__PORT EQU 2
LCD_Char_1_LCDPort__0__SHIFT EQU 0
LCD_Char_1_LCDPort__1__MASK EQU 0x02
LCD_Char_1_LCDPort__1__PC EQU CYREG_PRT2_PC1
LCD_Char_1_LCDPort__1__PORT EQU 2
LCD_Char_1_LCDPort__1__SHIFT EQU 1
LCD_Char_1_LCDPort__2__MASK EQU 0x04
LCD_Char_1_LCDPort__2__PC EQU CYREG_PRT2_PC2
LCD_Char_1_LCDPort__2__PORT EQU 2
LCD_Char_1_LCDPort__2__SHIFT EQU 2
LCD_Char_1_LCDPort__3__MASK EQU 0x08
LCD_Char_1_LCDPort__3__PC EQU CYREG_PRT2_PC3
LCD_Char_1_LCDPort__3__PORT EQU 2
LCD_Char_1_LCDPort__3__SHIFT EQU 3
LCD_Char_1_LCDPort__4__MASK EQU 0x10
LCD_Char_1_LCDPort__4__PC EQU CYREG_PRT2_PC4
LCD_Char_1_LCDPort__4__PORT EQU 2
LCD_Char_1_LCDPort__4__SHIFT EQU 4
LCD_Char_1_LCDPort__5__MASK EQU 0x20
LCD_Char_1_LCDPort__5__PC EQU CYREG_PRT2_PC5
LCD_Char_1_LCDPort__5__PORT EQU 2
LCD_Char_1_LCDPort__5__SHIFT EQU 5
LCD_Char_1_LCDPort__6__MASK EQU 0x40
LCD_Char_1_LCDPort__6__PC EQU CYREG_PRT2_PC6
LCD_Char_1_LCDPort__6__PORT EQU 2
LCD_Char_1_LCDPort__6__SHIFT EQU 6
LCD_Char_1_LCDPort__AG EQU CYREG_PRT2_AG
LCD_Char_1_LCDPort__AMUX EQU CYREG_PRT2_AMUX
LCD_Char_1_LCDPort__BIE EQU CYREG_PRT2_BIE
LCD_Char_1_LCDPort__BIT_MASK EQU CYREG_PRT2_BIT_MASK
LCD_Char_1_LCDPort__BYP EQU CYREG_PRT2_BYP
LCD_Char_1_LCDPort__CTL EQU CYREG_PRT2_CTL
LCD_Char_1_LCDPort__DM0 EQU CYREG_PRT2_DM0
LCD_Char_1_LCDPort__DM1 EQU CYREG_PRT2_DM1
LCD_Char_1_LCDPort__DM2 EQU CYREG_PRT2_DM2
LCD_Char_1_LCDPort__DR EQU CYREG_PRT2_DR
LCD_Char_1_LCDPort__INP_DIS EQU CYREG_PRT2_INP_DIS
LCD_Char_1_LCDPort__LCD_COM_SEG EQU CYREG_PRT2_LCD_COM_SEG
LCD_Char_1_LCDPort__LCD_EN EQU CYREG_PRT2_LCD_EN
LCD_Char_1_LCDPort__MASK EQU 0x7F
LCD_Char_1_LCDPort__PORT EQU 2
LCD_Char_1_LCDPort__PRT EQU CYREG_PRT2_PRT
LCD_Char_1_LCDPort__PRTDSI__CAPS_SEL EQU CYREG_PRT2_CAPS_SEL
LCD_Char_1_LCDPort__PRTDSI__DBL_SYNC_IN EQU CYREG_PRT2_DBL_SYNC_IN
LCD_Char_1_LCDPort__PRTDSI__OE_SEL0 EQU CYREG_PRT2_OE_SEL0
LCD_Char_1_LCDPort__PRTDSI__OE_SEL1 EQU CYREG_PRT2_OE_SEL1
LCD_Char_1_LCDPort__PRTDSI__OUT_SEL0 EQU CYREG_PRT2_OUT_SEL0
LCD_Char_1_LCDPort__PRTDSI__OUT_SEL1 EQU CYREG_PRT2_OUT_SEL1
LCD_Char_1_LCDPort__PRTDSI__SYNC_OUT EQU CYREG_PRT2_SYNC_OUT
LCD_Char_1_LCDPort__PS EQU CYREG_PRT2_PS
LCD_Char_1_LCDPort__SHIFT EQU 0
LCD_Char_1_LCDPort__SLW EQU CYREG_PRT2_SLW

; ADC_DelSig_1_DSM2
ADC_DelSig_1_DSM2__BUF0 EQU CYREG_DSM0_BUF0
ADC_DelSig_1_DSM2__BUF1 EQU CYREG_DSM0_BUF1
ADC_DelSig_1_DSM2__BUF2 EQU CYREG_DSM0_BUF2
ADC_DelSig_1_DSM2__BUF3 EQU CYREG_DSM0_BUF3
ADC_DelSig_1_DSM2__CLK EQU CYREG_DSM0_CLK
ADC_DelSig_1_DSM2__CR0 EQU CYREG_DSM0_CR0
ADC_DelSig_1_DSM2__CR1 EQU CYREG_DSM0_CR1
ADC_DelSig_1_DSM2__CR10 EQU CYREG_DSM0_CR10
ADC_DelSig_1_DSM2__CR11 EQU CYREG_DSM0_CR11
ADC_DelSig_1_DSM2__CR12 EQU CYREG_DSM0_CR12
ADC_DelSig_1_DSM2__CR13 EQU CYREG_DSM0_CR13
ADC_DelSig_1_DSM2__CR14 EQU CYREG_DSM0_CR14
ADC_DelSig_1_DSM2__CR15 EQU CYREG_DSM0_CR15
ADC_DelSig_1_DSM2__CR16 EQU CYREG_DSM0_CR16
ADC_DelSig_1_DSM2__CR17 EQU CYREG_DSM0_CR17
ADC_DelSig_1_DSM2__CR2 EQU CYREG_DSM0_CR2
ADC_DelSig_1_DSM2__CR3 EQU CYREG_DSM0_CR3
ADC_DelSig_1_DSM2__CR4 EQU CYREG_DSM0_CR4
ADC_DelSig_1_DSM2__CR5 EQU CYREG_DSM0_CR5
ADC_DelSig_1_DSM2__CR6 EQU CYREG_DSM0_CR6
ADC_DelSig_1_DSM2__CR7 EQU CYREG_DSM0_CR7
ADC_DelSig_1_DSM2__CR8 EQU CYREG_DSM0_CR8
ADC_DelSig_1_DSM2__CR9 EQU CYREG_DSM0_CR9
ADC_DelSig_1_DSM2__DEM0 EQU CYREG_DSM0_DEM0
ADC_DelSig_1_DSM2__DEM1 EQU CYREG_DSM0_DEM1
ADC_DelSig_1_DSM2__MISC EQU CYREG_DSM0_MISC
ADC_DelSig_1_DSM2__OUT0 EQU CYREG_DSM0_OUT0
ADC_DelSig_1_DSM2__OUT1 EQU CYREG_DSM0_OUT1
ADC_DelSig_1_DSM2__REF0 EQU CYREG_DSM0_REF0
ADC_DelSig_1_DSM2__REF1 EQU CYREG_DSM0_REF1
ADC_DelSig_1_DSM2__REF2 EQU CYREG_DSM0_REF2
ADC_DelSig_1_DSM2__REF3 EQU CYREG_DSM0_REF3
ADC_DelSig_1_DSM2__RSVD1 EQU CYREG_DSM0_RSVD1
ADC_DelSig_1_DSM2__SW0 EQU CYREG_DSM0_SW0
ADC_DelSig_1_DSM2__SW2 EQU CYREG_DSM0_SW2
ADC_DelSig_1_DSM2__SW3 EQU CYREG_DSM0_SW3
ADC_DelSig_1_DSM2__SW4 EQU CYREG_DSM0_SW4
ADC_DelSig_1_DSM2__SW6 EQU CYREG_DSM0_SW6
ADC_DelSig_1_DSM2__TR0 EQU CYREG_NPUMP_DSM_TR0
ADC_DelSig_1_DSM2__TST0 EQU CYREG_DSM0_TST0
ADC_DelSig_1_DSM2__TST1 EQU CYREG_DSM0_TST1

; CapSense_ClockGen
CapSense_ClockGen_AsyncCtrl_CtrlReg__0__MASK EQU 0x01
CapSense_ClockGen_AsyncCtrl_CtrlReg__0__POS EQU 0
CapSense_ClockGen_AsyncCtrl_CtrlReg__16BIT_CONTROL_AUX_CTL_REG EQU CYREG_B0_UDB04_05_ACTL
CapSense_ClockGen_AsyncCtrl_CtrlReg__16BIT_CONTROL_CONTROL_REG EQU CYREG_B0_UDB04_05_CTL
CapSense_ClockGen_AsyncCtrl_CtrlReg__16BIT_CONTROL_COUNT_REG EQU CYREG_B0_UDB04_05_CTL
CapSense_ClockGen_AsyncCtrl_CtrlReg__16BIT_COUNT_CONTROL_REG EQU CYREG_B0_UDB04_05_CTL
CapSense_ClockGen_AsyncCtrl_CtrlReg__16BIT_COUNT_COUNT_REG EQU CYREG_B0_UDB04_05_CTL
CapSense_ClockGen_AsyncCtrl_CtrlReg__16BIT_MASK_MASK_REG EQU CYREG_B0_UDB04_05_MSK
CapSense_ClockGen_AsyncCtrl_CtrlReg__16BIT_MASK_PERIOD_REG EQU CYREG_B0_UDB04_05_MSK
CapSense_ClockGen_AsyncCtrl_CtrlReg__16BIT_PERIOD_MASK_REG EQU CYREG_B0_UDB04_05_MSK
CapSense_ClockGen_AsyncCtrl_CtrlReg__16BIT_PERIOD_PERIOD_REG EQU CYREG_B0_UDB04_05_MSK
CapSense_ClockGen_AsyncCtrl_CtrlReg__1__MASK EQU 0x02
CapSense_ClockGen_AsyncCtrl_CtrlReg__1__POS EQU 1
CapSense_ClockGen_AsyncCtrl_CtrlReg__2__MASK EQU 0x04
CapSense_ClockGen_AsyncCtrl_CtrlReg__2__POS EQU 2
CapSense_ClockGen_AsyncCtrl_CtrlReg__4__MASK EQU 0x10
CapSense_ClockGen_AsyncCtrl_CtrlReg__4__POS EQU 4
CapSense_ClockGen_AsyncCtrl_CtrlReg__CONTROL_AUX_CTL_REG EQU CYREG_B0_UDB04_ACTL
CapSense_ClockGen_AsyncCtrl_CtrlReg__CONTROL_REG EQU CYREG_B0_UDB04_CTL
CapSense_ClockGen_AsyncCtrl_CtrlReg__CONTROL_ST_REG EQU CYREG_B0_UDB04_ST_CTL
CapSense_ClockGen_AsyncCtrl_CtrlReg__COUNT_REG EQU CYREG_B0_UDB04_CTL
CapSense_ClockGen_AsyncCtrl_CtrlReg__COUNT_ST_REG EQU CYREG_B0_UDB04_ST_CTL
CapSense_ClockGen_AsyncCtrl_CtrlReg__MASK EQU 0x17
CapSense_ClockGen_AsyncCtrl_CtrlReg__MASK_CTL_AUX_CTL_REG EQU CYREG_B0_UDB04_MSK_ACTL
CapSense_ClockGen_AsyncCtrl_CtrlReg__PERIOD_REG EQU CYREG_B0_UDB04_MSK
CapSense_ClockGen_AsyncCtrl_CtrlReg__PER_CTL_AUX_CTL_REG EQU CYREG_B0_UDB04_MSK_ACTL
CapSense_ClockGen_ScanSpeed__16BIT_CONTROL_AUX_CTL_REG EQU CYREG_B0_UDB05_06_ACTL
CapSense_ClockGen_ScanSpeed__16BIT_CONTROL_CONTROL_REG EQU CYREG_B0_UDB05_06_CTL
CapSense_ClockGen_ScanSpeed__16BIT_CONTROL_COUNT_REG EQU CYREG_B0_UDB05_06_CTL
CapSense_ClockGen_ScanSpeed__16BIT_COUNT_CONTROL_REG EQU CYREG_B0_UDB05_06_CTL
CapSense_ClockGen_ScanSpeed__16BIT_COUNT_COUNT_REG EQU CYREG_B0_UDB05_06_CTL
CapSense_ClockGen_ScanSpeed__16BIT_MASK_MASK_REG EQU CYREG_B0_UDB05_06_MSK
CapSense_ClockGen_ScanSpeed__16BIT_MASK_PERIOD_REG EQU CYREG_B0_UDB05_06_MSK
CapSense_ClockGen_ScanSpeed__16BIT_PERIOD_MASK_REG EQU CYREG_B0_UDB05_06_MSK
CapSense_ClockGen_ScanSpeed__16BIT_PERIOD_PERIOD_REG EQU CYREG_B0_UDB05_06_MSK
CapSense_ClockGen_ScanSpeed__CONTROL_AUX_CTL_REG EQU CYREG_B0_UDB05_ACTL
CapSense_ClockGen_ScanSpeed__CONTROL_REG EQU CYREG_B0_UDB05_CTL
CapSense_ClockGen_ScanSpeed__CONTROL_ST_REG EQU CYREG_B0_UDB05_ST_CTL
CapSense_ClockGen_ScanSpeed__COUNT_REG EQU CYREG_B0_UDB05_CTL
CapSense_ClockGen_ScanSpeed__COUNT_ST_REG EQU CYREG_B0_UDB05_ST_CTL
CapSense_ClockGen_ScanSpeed__MASK_CTL_AUX_CTL_REG EQU CYREG_B0_UDB05_MSK_ACTL
CapSense_ClockGen_ScanSpeed__PERIOD_REG EQU CYREG_B0_UDB05_MSK
CapSense_ClockGen_ScanSpeed__PER_CTL_AUX_CTL_REG EQU CYREG_B0_UDB05_MSK_ACTL
CapSense_ClockGen_UDB_PrescalerDp_u0__16BIT_A0_REG EQU CYREG_B0_UDB05_06_A0
CapSense_ClockGen_UDB_PrescalerDp_u0__16BIT_A1_REG EQU CYREG_B0_UDB05_06_A1
CapSense_ClockGen_UDB_PrescalerDp_u0__16BIT_D0_REG EQU CYREG_B0_UDB05_06_D0
CapSense_ClockGen_UDB_PrescalerDp_u0__16BIT_D1_REG EQU CYREG_B0_UDB05_06_D1
CapSense_ClockGen_UDB_PrescalerDp_u0__16BIT_DP_AUX_CTL_REG EQU CYREG_B0_UDB05_06_ACTL
CapSense_ClockGen_UDB_PrescalerDp_u0__16BIT_F0_REG EQU CYREG_B0_UDB05_06_F0
CapSense_ClockGen_UDB_PrescalerDp_u0__16BIT_F1_REG EQU CYREG_B0_UDB05_06_F1
CapSense_ClockGen_UDB_PrescalerDp_u0__A0_A1_REG EQU CYREG_B0_UDB05_A0_A1
CapSense_ClockGen_UDB_PrescalerDp_u0__A0_REG EQU CYREG_B0_UDB05_A0
CapSense_ClockGen_UDB_PrescalerDp_u0__A1_REG EQU CYREG_B0_UDB05_A1
CapSense_ClockGen_UDB_PrescalerDp_u0__D0_D1_REG EQU CYREG_B0_UDB05_D0_D1
CapSense_ClockGen_UDB_PrescalerDp_u0__D0_REG EQU CYREG_B0_UDB05_D0
CapSense_ClockGen_UDB_PrescalerDp_u0__D1_REG EQU CYREG_B0_UDB05_D1
CapSense_ClockGen_UDB_PrescalerDp_u0__DP_AUX_CTL_REG EQU CYREG_B0_UDB05_ACTL
CapSense_ClockGen_UDB_PrescalerDp_u0__F0_F1_REG EQU CYREG_B0_UDB05_F0_F1
CapSense_ClockGen_UDB_PrescalerDp_u0__F0_REG EQU CYREG_B0_UDB05_F0
CapSense_ClockGen_UDB_PrescalerDp_u0__F1_REG EQU CYREG_B0_UDB05_F1
CapSense_ClockGen_UDB_PrescalerDp_u0__MSK_DP_AUX_CTL_REG EQU CYREG_B0_UDB05_MSK_ACTL
CapSense_ClockGen_UDB_PrescalerDp_u0__PER_DP_AUX_CTL_REG EQU CYREG_B0_UDB05_MSK_ACTL
CapSense_ClockGen_sC16_PRSdp_u0__16BIT_A0_REG EQU CYREG_B0_UDB03_04_A0
CapSense_ClockGen_sC16_PRSdp_u0__16BIT_A1_REG EQU CYREG_B0_UDB03_04_A1
CapSense_ClockGen_sC16_PRSdp_u0__16BIT_D0_REG EQU CYREG_B0_UDB03_04_D0
CapSense_ClockGen_sC16_PRSdp_u0__16BIT_D1_REG EQU CYREG_B0_UDB03_04_D1
CapSense_ClockGen_sC16_PRSdp_u0__16BIT_DP_AUX_CTL_REG EQU CYREG_B0_UDB03_04_ACTL
CapSense_ClockGen_sC16_PRSdp_u0__16BIT_F0_REG EQU CYREG_B0_UDB03_04_F0
CapSense_ClockGen_sC16_PRSdp_u0__16BIT_F1_REG EQU CYREG_B0_UDB03_04_F1
CapSense_ClockGen_sC16_PRSdp_u0__A0_A1_REG EQU CYREG_B0_UDB03_A0_A1
CapSense_ClockGen_sC16_PRSdp_u0__A0_REG EQU CYREG_B0_UDB03_A0
CapSense_ClockGen_sC16_PRSdp_u0__A1_REG EQU CYREG_B0_UDB03_A1
CapSense_ClockGen_sC16_PRSdp_u0__D0_D1_REG EQU CYREG_B0_UDB03_D0_D1
CapSense_ClockGen_sC16_PRSdp_u0__D0_REG EQU CYREG_B0_UDB03_D0
CapSense_ClockGen_sC16_PRSdp_u0__D1_REG EQU CYREG_B0_UDB03_D1
CapSense_ClockGen_sC16_PRSdp_u0__DP_AUX_CTL_REG EQU CYREG_B0_UDB03_ACTL
CapSense_ClockGen_sC16_PRSdp_u0__F0_F1_REG EQU CYREG_B0_UDB03_F0_F1
CapSense_ClockGen_sC16_PRSdp_u0__F0_REG EQU CYREG_B0_UDB03_F0
CapSense_ClockGen_sC16_PRSdp_u0__F1_REG EQU CYREG_B0_UDB03_F1
CapSense_ClockGen_sC16_PRSdp_u1__16BIT_A0_REG EQU CYREG_B0_UDB04_05_A0
CapSense_ClockGen_sC16_PRSdp_u1__16BIT_A1_REG EQU CYREG_B0_UDB04_05_A1
CapSense_ClockGen_sC16_PRSdp_u1__16BIT_D0_REG EQU CYREG_B0_UDB04_05_D0
CapSense_ClockGen_sC16_PRSdp_u1__16BIT_D1_REG EQU CYREG_B0_UDB04_05_D1
CapSense_ClockGen_sC16_PRSdp_u1__16BIT_DP_AUX_CTL_REG EQU CYREG_B0_UDB04_05_ACTL
CapSense_ClockGen_sC16_PRSdp_u1__16BIT_F0_REG EQU CYREG_B0_UDB04_05_F0
CapSense_ClockGen_sC16_PRSdp_u1__16BIT_F1_REG EQU CYREG_B0_UDB04_05_F1
CapSense_ClockGen_sC16_PRSdp_u1__A0_A1_REG EQU CYREG_B0_UDB04_A0_A1
CapSense_ClockGen_sC16_PRSdp_u1__A0_REG EQU CYREG_B0_UDB04_A0
CapSense_ClockGen_sC16_PRSdp_u1__A1_REG EQU CYREG_B0_UDB04_A1
CapSense_ClockGen_sC16_PRSdp_u1__D0_D1_REG EQU CYREG_B0_UDB04_D0_D1
CapSense_ClockGen_sC16_PRSdp_u1__D0_REG EQU CYREG_B0_UDB04_D0
CapSense_ClockGen_sC16_PRSdp_u1__D1_REG EQU CYREG_B0_UDB04_D1
CapSense_ClockGen_sC16_PRSdp_u1__DP_AUX_CTL_REG EQU CYREG_B0_UDB04_ACTL
CapSense_ClockGen_sC16_PRSdp_u1__F0_F1_REG EQU CYREG_B0_UDB04_F0_F1
CapSense_ClockGen_sC16_PRSdp_u1__F0_REG EQU CYREG_B0_UDB04_F0
CapSense_ClockGen_sC16_PRSdp_u1__F1_REG EQU CYREG_B0_UDB04_F1
CapSense_ClockGen_sC16_PRSdp_u1__MSK_DP_AUX_CTL_REG EQU CYREG_B0_UDB04_MSK_ACTL
CapSense_ClockGen_sC16_PRSdp_u1__PER_DP_AUX_CTL_REG EQU CYREG_B0_UDB04_MSK_ACTL

; CapSense_IntClock
CapSense_IntClock__CFG0 EQU CYREG_CLKDIST_DCFG0_CFG0
CapSense_IntClock__CFG1 EQU CYREG_CLKDIST_DCFG0_CFG1
CapSense_IntClock__CFG2 EQU CYREG_CLKDIST_DCFG0_CFG2
CapSense_IntClock__CFG2_SRC_SEL_MASK EQU 0x07
CapSense_IntClock__PM_ACT_CFG EQU CYREG_PM_ACT_CFG2
CapSense_IntClock__PM_ACT_MSK EQU 0x01
CapSense_IntClock__PM_STBY_CFG EQU CYREG_PM_STBY_CFG2
CapSense_IntClock__PM_STBY_MSK EQU 0x01

; ADC_DelSig_1_DEC
ADC_DelSig_1_DEC__COHER EQU CYREG_DEC_COHER
ADC_DelSig_1_DEC__CR EQU CYREG_DEC_CR
ADC_DelSig_1_DEC__DR1 EQU CYREG_DEC_DR1
ADC_DelSig_1_DEC__DR2 EQU CYREG_DEC_DR2
ADC_DelSig_1_DEC__DR2H EQU CYREG_DEC_DR2H
ADC_DelSig_1_DEC__GCOR EQU CYREG_DEC_GCOR
ADC_DelSig_1_DEC__GCORH EQU CYREG_DEC_GCORH
ADC_DelSig_1_DEC__GVAL EQU CYREG_DEC_GVAL
ADC_DelSig_1_DEC__OCOR EQU CYREG_DEC_OCOR
ADC_DelSig_1_DEC__OCORH EQU CYREG_DEC_OCORH
ADC_DelSig_1_DEC__OCORM EQU CYREG_DEC_OCORM
ADC_DelSig_1_DEC__OUTSAMP EQU CYREG_DEC_OUTSAMP
ADC_DelSig_1_DEC__OUTSAMPH EQU CYREG_DEC_OUTSAMPH
ADC_DelSig_1_DEC__OUTSAMPM EQU CYREG_DEC_OUTSAMPM
ADC_DelSig_1_DEC__PM_ACT_CFG EQU CYREG_PM_ACT_CFG10
ADC_DelSig_1_DEC__PM_ACT_MSK EQU 0x01
ADC_DelSig_1_DEC__PM_STBY_CFG EQU CYREG_PM_STBY_CFG10
ADC_DelSig_1_DEC__PM_STBY_MSK EQU 0x01
ADC_DelSig_1_DEC__SHIFT1 EQU CYREG_DEC_SHIFT1
ADC_DelSig_1_DEC__SHIFT2 EQU CYREG_DEC_SHIFT2
ADC_DelSig_1_DEC__SR EQU CYREG_DEC_SR
ADC_DelSig_1_DEC__TRIM__16H EQU CYREG_FLSHID_CUST_TABLES_DEC_16H
ADC_DelSig_1_DEC__TRIM__16L EQU CYREG_FLSHID_CUST_TABLES_DEC_16L
ADC_DelSig_1_DEC__TRIM__1H EQU CYREG_FLSHID_CUST_TABLES_DEC_1H
ADC_DelSig_1_DEC__TRIM__1L EQU CYREG_FLSHID_CUST_TABLES_DEC_1L
ADC_DelSig_1_DEC__TRIM__4H EQU CYREG_FLSHID_CUST_TABLES_DEC_4H
ADC_DelSig_1_DEC__TRIM__4L EQU CYREG_FLSHID_CUST_TABLES_DEC_4L
ADC_DelSig_1_DEC__TRIM__P25H EQU CYREG_FLSHID_CUST_TABLES_DEC_P25H
ADC_DelSig_1_DEC__TRIM__P25L EQU CYREG_FLSHID_CUST_TABLES_DEC_P25L

; ADC_DelSig_1_IRQ
ADC_DelSig_1_IRQ__ES2_PATCH EQU 0
ADC_DelSig_1_IRQ__INTC_CLR_EN_REG EQU CYREG_INTC_CLR_EN3
ADC_DelSig_1_IRQ__INTC_CLR_PD_REG EQU CYREG_INTC_CLR_PD3
ADC_DelSig_1_IRQ__INTC_MASK EQU 0x20
ADC_DelSig_1_IRQ__INTC_NUMBER EQU 29
ADC_DelSig_1_IRQ__INTC_PRIOR_NUM EQU 7
ADC_DelSig_1_IRQ__INTC_PRIOR_REG EQU CYREG_INTC_PRIOR29
ADC_DelSig_1_IRQ__INTC_SET_EN_REG EQU CYREG_INTC_SET_EN3
ADC_DelSig_1_IRQ__INTC_SET_PD_REG EQU CYREG_INTC_SET_PD3
ADC_DelSig_1_IRQ__INTC_VECT EQU (CYREG_INTC_VECT_MBASE+0x3A)

; CapSense_CmodCH0
CapSense_CmodCH0__0__MASK EQU 0x80
CapSense_CmodCH0__0__PC EQU CYREG_PRT2_PC7
CapSense_CmodCH0__0__PORT EQU 2
CapSense_CmodCH0__0__SHIFT EQU 7
CapSense_CmodCH0__AG EQU CYREG_PRT2_AG
CapSense_CmodCH0__AMUX EQU CYREG_PRT2_AMUX
CapSense_CmodCH0__BIE EQU CYREG_PRT2_BIE
CapSense_CmodCH0__BIT_MASK EQU CYREG_PRT2_BIT_MASK
CapSense_CmodCH0__BYP EQU CYREG_PRT2_BYP
CapSense_CmodCH0__CTL EQU CYREG_PRT2_CTL
CapSense_CmodCH0__Cmod_CH0__MASK EQU 0x80
CapSense_CmodCH0__Cmod_CH0__PC EQU CYREG_PRT2_PC7
CapSense_CmodCH0__Cmod_CH0__PORT EQU 2
CapSense_CmodCH0__Cmod_CH0__SHIFT EQU 7
CapSense_CmodCH0__DM0 EQU CYREG_PRT2_DM0
CapSense_CmodCH0__DM1 EQU CYREG_PRT2_DM1
CapSense_CmodCH0__DM2 EQU CYREG_PRT2_DM2
CapSense_CmodCH0__DR EQU CYREG_PRT2_DR
CapSense_CmodCH0__INP_DIS EQU CYREG_PRT2_INP_DIS
CapSense_CmodCH0__LCD_COM_SEG EQU CYREG_PRT2_LCD_COM_SEG
CapSense_CmodCH0__LCD_EN EQU CYREG_PRT2_LCD_EN
CapSense_CmodCH0__PORT EQU 2
CapSense_CmodCH0__PRT EQU CYREG_PRT2_PRT
CapSense_CmodCH0__PRTDSI__CAPS_SEL EQU CYREG_PRT2_CAPS_SEL
CapSense_CmodCH0__PRTDSI__DBL_SYNC_IN EQU CYREG_PRT2_DBL_SYNC_IN
CapSense_CmodCH0__PRTDSI__OE_SEL0 EQU CYREG_PRT2_OE_SEL0
CapSense_CmodCH0__PRTDSI__OE_SEL1 EQU CYREG_PRT2_OE_SEL1
CapSense_CmodCH0__PRTDSI__OUT_SEL0 EQU CYREG_PRT2_OUT_SEL0
CapSense_CmodCH0__PRTDSI__OUT_SEL1 EQU CYREG_PRT2_OUT_SEL1
CapSense_CmodCH0__PRTDSI__SYNC_OUT EQU CYREG_PRT2_SYNC_OUT
CapSense_CmodCH0__PS EQU CYREG_PRT2_PS
CapSense_CmodCH0__SLW EQU CYREG_PRT2_SLW

; CapSense_IdacCH0
CapSense_IdacCH0__CR0 EQU CYREG_DAC0_CR0
CapSense_IdacCH0__CR1 EQU CYREG_DAC0_CR1
CapSense_IdacCH0__D EQU CYREG_DAC0_D
CapSense_IdacCH0__PM_ACT_CFG EQU CYREG_PM_ACT_CFG8
CapSense_IdacCH0__PM_ACT_MSK EQU 0x01
CapSense_IdacCH0__PM_STBY_CFG EQU CYREG_PM_STBY_CFG8
CapSense_IdacCH0__PM_STBY_MSK EQU 0x01
CapSense_IdacCH0__STROBE EQU CYREG_DAC0_STROBE
CapSense_IdacCH0__SW0 EQU CYREG_DAC0_SW0
CapSense_IdacCH0__SW2 EQU CYREG_DAC0_SW2
CapSense_IdacCH0__SW3 EQU CYREG_DAC0_SW3
CapSense_IdacCH0__SW4 EQU CYREG_DAC0_SW4
CapSense_IdacCH0__TR EQU CYREG_DAC0_TR
CapSense_IdacCH0__TRIM__M1 EQU CYREG_FLSHID_CUST_TABLES_DAC0_M1
CapSense_IdacCH0__TRIM__M2 EQU CYREG_FLSHID_CUST_TABLES_DAC0_M2
CapSense_IdacCH0__TRIM__M3 EQU CYREG_FLSHID_CUST_TABLES_DAC0_M3
CapSense_IdacCH0__TRIM__M4 EQU CYREG_FLSHID_CUST_TABLES_DAC0_M4
CapSense_IdacCH0__TRIM__M5 EQU CYREG_FLSHID_CUST_TABLES_DAC0_M5
CapSense_IdacCH0__TRIM__M6 EQU CYREG_FLSHID_CUST_TABLES_DAC0_M6
CapSense_IdacCH0__TRIM__M7 EQU CYREG_FLSHID_CUST_TABLES_DAC0_M7
CapSense_IdacCH0__TRIM__M8 EQU CYREG_FLSHID_CUST_TABLES_DAC0_M8
CapSense_IdacCH0__TRIM__TR EQU CYREG_FLSHID_MFG_CFG_DAC0_TR
CapSense_IdacCH0__TST EQU CYREG_DAC0_TST

; CapSense_PortCH0
CapSense_PortCH0__0__MASK EQU 0x40
CapSense_PortCH0__0__PC EQU CYREG_PRT0_PC6
CapSense_PortCH0__0__PORT EQU 0
CapSense_PortCH0__0__SHIFT EQU 6
CapSense_PortCH0__1__MASK EQU 0x20
CapSense_PortCH0__1__PC EQU CYREG_PRT0_PC5
CapSense_PortCH0__1__PORT EQU 0
CapSense_PortCH0__1__SHIFT EQU 5
CapSense_PortCH0__AG EQU CYREG_PRT0_AG
CapSense_PortCH0__AMUX EQU CYREG_PRT0_AMUX
CapSense_PortCH0__BIE EQU CYREG_PRT0_BIE
CapSense_PortCH0__BIT_MASK EQU CYREG_PRT0_BIT_MASK
CapSense_PortCH0__BYP EQU CYREG_PRT0_BYP
CapSense_PortCH0__Button0__BTN__MASK EQU 0x40
CapSense_PortCH0__Button0__BTN__PC EQU CYREG_PRT0_PC6
CapSense_PortCH0__Button0__BTN__PORT EQU 0
CapSense_PortCH0__Button0__BTN__SHIFT EQU 6
CapSense_PortCH0__Button1__BTN__MASK EQU 0x20
CapSense_PortCH0__Button1__BTN__PC EQU CYREG_PRT0_PC5
CapSense_PortCH0__Button1__BTN__PORT EQU 0
CapSense_PortCH0__Button1__BTN__SHIFT EQU 5
CapSense_PortCH0__CTL EQU CYREG_PRT0_CTL
CapSense_PortCH0__DM0 EQU CYREG_PRT0_DM0
CapSense_PortCH0__DM1 EQU CYREG_PRT0_DM1
CapSense_PortCH0__DM2 EQU CYREG_PRT0_DM2
CapSense_PortCH0__DR EQU CYREG_PRT0_DR
CapSense_PortCH0__INP_DIS EQU CYREG_PRT0_INP_DIS
CapSense_PortCH0__LCD_COM_SEG EQU CYREG_PRT0_LCD_COM_SEG
CapSense_PortCH0__LCD_EN EQU CYREG_PRT0_LCD_EN
CapSense_PortCH0__PORT EQU 0
CapSense_PortCH0__PRT EQU CYREG_PRT0_PRT
CapSense_PortCH0__PRTDSI__CAPS_SEL EQU CYREG_PRT0_CAPS_SEL
CapSense_PortCH0__PRTDSI__DBL_SYNC_IN EQU CYREG_PRT0_DBL_SYNC_IN
CapSense_PortCH0__PRTDSI__OE_SEL0 EQU CYREG_PRT0_OE_SEL0
CapSense_PortCH0__PRTDSI__OE_SEL1 EQU CYREG_PRT0_OE_SEL1
CapSense_PortCH0__PRTDSI__OUT_SEL0 EQU CYREG_PRT0_OUT_SEL0
CapSense_PortCH0__PRTDSI__OUT_SEL1 EQU CYREG_PRT0_OUT_SEL1
CapSense_PortCH0__PRTDSI__SYNC_OUT EQU CYREG_PRT0_SYNC_OUT
CapSense_PortCH0__PS EQU CYREG_PRT0_PS
CapSense_PortCH0__SLW EQU CYREG_PRT0_SLW

; CapSense_BufCH0
CapSense_BufCH0__CFG0 EQU CYREG_CAPSL_CFG0
CapSense_BufCH0__CFG1 EQU CYREG_CAPSL_CFG1
CapSense_BufCH0__PM_ACT_CFG EQU CYREG_PM_ACT_CFG11
CapSense_BufCH0__PM_ACT_MSK EQU 0x10
CapSense_BufCH0__PM_STBY_CFG EQU CYREG_PM_STBY_CFG11
CapSense_BufCH0__PM_STBY_MSK EQU 0x10

; CapSense_IsrCH0
CapSense_IsrCH0__ES2_PATCH EQU 0
CapSense_IsrCH0__INTC_CLR_EN_REG EQU CYREG_INTC_CLR_EN1
CapSense_IsrCH0__INTC_CLR_PD_REG EQU CYREG_INTC_CLR_PD1
CapSense_IsrCH0__INTC_MASK EQU 0x40
CapSense_IsrCH0__INTC_NUMBER EQU 14
CapSense_IsrCH0__INTC_PRIOR_NUM EQU 7
CapSense_IsrCH0__INTC_PRIOR_REG EQU CYREG_INTC_PRIOR14
CapSense_IsrCH0__INTC_SET_EN_REG EQU CYREG_INTC_SET_EN1
CapSense_IsrCH0__INTC_SET_PD_REG EQU CYREG_INTC_SET_PD1
CapSense_IsrCH0__INTC_VECT EQU (CYREG_INTC_VECT_MBASE+0x1C)

; PWM_1_PWMUDB
PWM_1_PWMUDB_sCTRLReg_AsyncCtl_ctrlreg__0__MASK EQU 0x01
PWM_1_PWMUDB_sCTRLReg_AsyncCtl_ctrlreg__0__POS EQU 0
PWM_1_PWMUDB_sCTRLReg_AsyncCtl_ctrlreg__16BIT_CONTROL_AUX_CTL_REG EQU CYREG_B1_UDB06_07_ACTL
PWM_1_PWMUDB_sCTRLReg_AsyncCtl_ctrlreg__16BIT_CONTROL_CONTROL_REG EQU CYREG_B1_UDB06_07_CTL
PWM_1_PWMUDB_sCTRLReg_AsyncCtl_ctrlreg__16BIT_CONTROL_COUNT_REG EQU CYREG_B1_UDB06_07_CTL
PWM_1_PWMUDB_sCTRLReg_AsyncCtl_ctrlreg__16BIT_COUNT_CONTROL_REG EQU CYREG_B1_UDB06_07_CTL
PWM_1_PWMUDB_sCTRLReg_AsyncCtl_ctrlreg__16BIT_COUNT_COUNT_REG EQU CYREG_B1_UDB06_07_CTL
PWM_1_PWMUDB_sCTRLReg_AsyncCtl_ctrlreg__16BIT_MASK_MASK_REG EQU CYREG_B1_UDB06_07_MSK
PWM_1_PWMUDB_sCTRLReg_AsyncCtl_ctrlreg__16BIT_MASK_PERIOD_REG EQU CYREG_B1_UDB06_07_MSK
PWM_1_PWMUDB_sCTRLReg_AsyncCtl_ctrlreg__16BIT_PERIOD_MASK_REG EQU CYREG_B1_UDB06_07_MSK
PWM_1_PWMUDB_sCTRLReg_AsyncCtl_ctrlreg__16BIT_PERIOD_PERIOD_REG EQU CYREG_B1_UDB06_07_MSK
PWM_1_PWMUDB_sCTRLReg_AsyncCtl_ctrlreg__1__MASK EQU 0x02
PWM_1_PWMUDB_sCTRLReg_AsyncCtl_ctrlreg__1__POS EQU 1
PWM_1_PWMUDB_sCTRLReg_AsyncCtl_ctrlreg__2__MASK EQU 0x04
PWM_1_PWMUDB_sCTRLReg_AsyncCtl_ctrlreg__2__POS EQU 2
PWM_1_PWMUDB_sCTRLReg_AsyncCtl_ctrlreg__7__MASK EQU 0x80
PWM_1_PWMUDB_sCTRLReg_AsyncCtl_ctrlreg__7__POS EQU 7
PWM_1_PWMUDB_sCTRLReg_AsyncCtl_ctrlreg__CONTROL_AUX_CTL_REG EQU CYREG_B1_UDB06_ACTL
PWM_1_PWMUDB_sCTRLReg_AsyncCtl_ctrlreg__CONTROL_REG EQU CYREG_B1_UDB06_CTL
PWM_1_PWMUDB_sCTRLReg_AsyncCtl_ctrlreg__CONTROL_ST_REG EQU CYREG_B1_UDB06_ST_CTL
PWM_1_PWMUDB_sCTRLReg_AsyncCtl_ctrlreg__COUNT_REG EQU CYREG_B1_UDB06_CTL
PWM_1_PWMUDB_sCTRLReg_AsyncCtl_ctrlreg__COUNT_ST_REG EQU CYREG_B1_UDB06_ST_CTL
PWM_1_PWMUDB_sCTRLReg_AsyncCtl_ctrlreg__MASK EQU 0x87
PWM_1_PWMUDB_sCTRLReg_AsyncCtl_ctrlreg__MASK_CTL_AUX_CTL_REG EQU CYREG_B1_UDB06_MSK_ACTL
PWM_1_PWMUDB_sCTRLReg_AsyncCtl_ctrlreg__PERIOD_REG EQU CYREG_B1_UDB06_MSK
PWM_1_PWMUDB_sCTRLReg_AsyncCtl_ctrlreg__PER_CTL_AUX_CTL_REG EQU CYREG_B1_UDB06_MSK_ACTL
PWM_1_PWMUDB_sP16_pwmdp_u0__16BIT_A0_REG EQU CYREG_B1_UDB05_06_A0
PWM_1_PWMUDB_sP16_pwmdp_u0__16BIT_A1_REG EQU CYREG_B1_UDB05_06_A1
PWM_1_PWMUDB_sP16_pwmdp_u0__16BIT_D0_REG EQU CYREG_B1_UDB05_06_D0
PWM_1_PWMUDB_sP16_pwmdp_u0__16BIT_D1_REG EQU CYREG_B1_UDB05_06_D1
PWM_1_PWMUDB_sP16_pwmdp_u0__16BIT_DP_AUX_CTL_REG EQU CYREG_B1_UDB05_06_ACTL
PWM_1_PWMUDB_sP16_pwmdp_u0__16BIT_F0_REG EQU CYREG_B1_UDB05_06_F0
PWM_1_PWMUDB_sP16_pwmdp_u0__16BIT_F1_REG EQU CYREG_B1_UDB05_06_F1
PWM_1_PWMUDB_sP16_pwmdp_u0__A0_A1_REG EQU CYREG_B1_UDB05_A0_A1
PWM_1_PWMUDB_sP16_pwmdp_u0__A0_REG EQU CYREG_B1_UDB05_A0
PWM_1_PWMUDB_sP16_pwmdp_u0__A1_REG EQU CYREG_B1_UDB05_A1
PWM_1_PWMUDB_sP16_pwmdp_u0__D0_D1_REG EQU CYREG_B1_UDB05_D0_D1
PWM_1_PWMUDB_sP16_pwmdp_u0__D0_REG EQU CYREG_B1_UDB05_D0
PWM_1_PWMUDB_sP16_pwmdp_u0__D1_REG EQU CYREG_B1_UDB05_D1
PWM_1_PWMUDB_sP16_pwmdp_u0__DP_AUX_CTL_REG EQU CYREG_B1_UDB05_ACTL
PWM_1_PWMUDB_sP16_pwmdp_u0__F0_F1_REG EQU CYREG_B1_UDB05_F0_F1
PWM_1_PWMUDB_sP16_pwmdp_u0__F0_REG EQU CYREG_B1_UDB05_F0
PWM_1_PWMUDB_sP16_pwmdp_u0__F1_REG EQU CYREG_B1_UDB05_F1
PWM_1_PWMUDB_sP16_pwmdp_u1__16BIT_A0_REG EQU CYREG_B1_UDB06_07_A0
PWM_1_PWMUDB_sP16_pwmdp_u1__16BIT_A1_REG EQU CYREG_B1_UDB06_07_A1
PWM_1_PWMUDB_sP16_pwmdp_u1__16BIT_D0_REG EQU CYREG_B1_UDB06_07_D0
PWM_1_PWMUDB_sP16_pwmdp_u1__16BIT_D1_REG EQU CYREG_B1_UDB06_07_D1
PWM_1_PWMUDB_sP16_pwmdp_u1__16BIT_DP_AUX_CTL_REG EQU CYREG_B1_UDB06_07_ACTL
PWM_1_PWMUDB_sP16_pwmdp_u1__16BIT_F0_REG EQU CYREG_B1_UDB06_07_F0
PWM_1_PWMUDB_sP16_pwmdp_u1__16BIT_F1_REG EQU CYREG_B1_UDB06_07_F1
PWM_1_PWMUDB_sP16_pwmdp_u1__A0_A1_REG EQU CYREG_B1_UDB06_A0_A1
PWM_1_PWMUDB_sP16_pwmdp_u1__A0_REG EQU CYREG_B1_UDB06_A0
PWM_1_PWMUDB_sP16_pwmdp_u1__A1_REG EQU CYREG_B1_UDB06_A1
PWM_1_PWMUDB_sP16_pwmdp_u1__D0_D1_REG EQU CYREG_B1_UDB06_D0_D1
PWM_1_PWMUDB_sP16_pwmdp_u1__D0_REG EQU CYREG_B1_UDB06_D0
PWM_1_PWMUDB_sP16_pwmdp_u1__D1_REG EQU CYREG_B1_UDB06_D1
PWM_1_PWMUDB_sP16_pwmdp_u1__DP_AUX_CTL_REG EQU CYREG_B1_UDB06_ACTL
PWM_1_PWMUDB_sP16_pwmdp_u1__F0_F1_REG EQU CYREG_B1_UDB06_F0_F1
PWM_1_PWMUDB_sP16_pwmdp_u1__F0_REG EQU CYREG_B1_UDB06_F0
PWM_1_PWMUDB_sP16_pwmdp_u1__F1_REG EQU CYREG_B1_UDB06_F1
PWM_1_PWMUDB_sP16_pwmdp_u1__MSK_DP_AUX_CTL_REG EQU CYREG_B1_UDB06_MSK_ACTL
PWM_1_PWMUDB_sP16_pwmdp_u1__PER_DP_AUX_CTL_REG EQU CYREG_B1_UDB06_MSK_ACTL
PWM_1_PWMUDB_sSTSReg_nrstSts_stsreg__0__MASK EQU 0x01
PWM_1_PWMUDB_sSTSReg_nrstSts_stsreg__0__POS EQU 0
PWM_1_PWMUDB_sSTSReg_nrstSts_stsreg__16BIT_STATUS_AUX_CTL_REG EQU CYREG_B1_UDB06_07_ACTL
PWM_1_PWMUDB_sSTSReg_nrstSts_stsreg__16BIT_STATUS_REG EQU CYREG_B1_UDB06_07_ST
PWM_1_PWMUDB_sSTSReg_nrstSts_stsreg__2__MASK EQU 0x04
PWM_1_PWMUDB_sSTSReg_nrstSts_stsreg__2__POS EQU 2
PWM_1_PWMUDB_sSTSReg_nrstSts_stsreg__3__MASK EQU 0x08
PWM_1_PWMUDB_sSTSReg_nrstSts_stsreg__3__POS EQU 3
PWM_1_PWMUDB_sSTSReg_nrstSts_stsreg__5__MASK EQU 0x20
PWM_1_PWMUDB_sSTSReg_nrstSts_stsreg__5__POS EQU 5
PWM_1_PWMUDB_sSTSReg_nrstSts_stsreg__MASK EQU 0x2D
PWM_1_PWMUDB_sSTSReg_nrstSts_stsreg__MASK_REG EQU CYREG_B1_UDB06_MSK
PWM_1_PWMUDB_sSTSReg_nrstSts_stsreg__MASK_ST_AUX_CTL_REG EQU CYREG_B1_UDB06_MSK_ACTL
PWM_1_PWMUDB_sSTSReg_nrstSts_stsreg__PER_ST_AUX_CTL_REG EQU CYREG_B1_UDB06_MSK_ACTL
PWM_1_PWMUDB_sSTSReg_nrstSts_stsreg__STATUS_AUX_CTL_REG EQU CYREG_B1_UDB06_ACTL
PWM_1_PWMUDB_sSTSReg_nrstSts_stsreg__STATUS_CNT_REG EQU CYREG_B1_UDB06_ST_CTL
PWM_1_PWMUDB_sSTSReg_nrstSts_stsreg__STATUS_CONTROL_REG EQU CYREG_B1_UDB06_ST_CTL
PWM_1_PWMUDB_sSTSReg_nrstSts_stsreg__STATUS_REG EQU CYREG_B1_UDB06_ST

; Clock_1
Clock_1__CFG0 EQU CYREG_CLKDIST_DCFG1_CFG0
Clock_1__CFG1 EQU CYREG_CLKDIST_DCFG1_CFG1
Clock_1__CFG2 EQU CYREG_CLKDIST_DCFG1_CFG2
Clock_1__CFG2_SRC_SEL_MASK EQU 0x07
Clock_1__PM_ACT_CFG EQU CYREG_PM_ACT_CFG2
Clock_1__PM_ACT_MSK EQU 0x02
Clock_1__PM_STBY_CFG EQU CYREG_PM_STBY_CFG2
Clock_1__PM_STBY_MSK EQU 0x02

; COLD
COLD__0__MASK EQU 0x40
COLD__0__PC EQU CYREG_PRT1_PC6
COLD__0__PORT EQU 1
COLD__0__SHIFT EQU 6
COLD__AG EQU CYREG_PRT1_AG
COLD__AMUX EQU CYREG_PRT1_AMUX
COLD__BIE EQU CYREG_PRT1_BIE
COLD__BIT_MASK EQU CYREG_PRT1_BIT_MASK
COLD__BYP EQU CYREG_PRT1_BYP
COLD__CTL EQU CYREG_PRT1_CTL
COLD__DM0 EQU CYREG_PRT1_DM0
COLD__DM1 EQU CYREG_PRT1_DM1
COLD__DM2 EQU CYREG_PRT1_DM2
COLD__DR EQU CYREG_PRT1_DR
COLD__INP_DIS EQU CYREG_PRT1_INP_DIS
COLD__LCD_COM_SEG EQU CYREG_PRT1_LCD_COM_SEG
COLD__LCD_EN EQU CYREG_PRT1_LCD_EN
COLD__MASK EQU 0x40
COLD__PORT EQU 1
COLD__PRT EQU CYREG_PRT1_PRT
COLD__PRTDSI__CAPS_SEL EQU CYREG_PRT1_CAPS_SEL
COLD__PRTDSI__DBL_SYNC_IN EQU CYREG_PRT1_DBL_SYNC_IN
COLD__PRTDSI__OE_SEL0 EQU CYREG_PRT1_OE_SEL0
COLD__PRTDSI__OE_SEL1 EQU CYREG_PRT1_OE_SEL1
COLD__PRTDSI__OUT_SEL0 EQU CYREG_PRT1_OUT_SEL0
COLD__PRTDSI__OUT_SEL1 EQU CYREG_PRT1_OUT_SEL1
COLD__PRTDSI__SYNC_OUT EQU CYREG_PRT1_SYNC_OUT
COLD__PS EQU CYREG_PRT1_PS
COLD__SHIFT EQU 6
COLD__SLW EQU CYREG_PRT1_SLW

; POT
POT__0__MASK EQU 0x04
POT__0__PC EQU CYREG_PRT1_PC2
POT__0__PORT EQU 1
POT__0__SHIFT EQU 2
POT__AG EQU CYREG_PRT1_AG
POT__AMUX EQU CYREG_PRT1_AMUX
POT__BIE EQU CYREG_PRT1_BIE
POT__BIT_MASK EQU CYREG_PRT1_BIT_MASK
POT__BYP EQU CYREG_PRT1_BYP
POT__CTL EQU CYREG_PRT1_CTL
POT__DM0 EQU CYREG_PRT1_DM0
POT__DM1 EQU CYREG_PRT1_DM1
POT__DM2 EQU CYREG_PRT1_DM2
POT__DR EQU CYREG_PRT1_DR
POT__INP_DIS EQU CYREG_PRT1_INP_DIS
POT__LCD_COM_SEG EQU CYREG_PRT1_LCD_COM_SEG
POT__LCD_EN EQU CYREG_PRT1_LCD_EN
POT__PORT EQU 1
POT__PRT EQU CYREG_PRT1_PRT
POT__PRTDSI__CAPS_SEL EQU CYREG_PRT1_CAPS_SEL
POT__PRTDSI__DBL_SYNC_IN EQU CYREG_PRT1_DBL_SYNC_IN
POT__PRTDSI__OE_SEL0 EQU CYREG_PRT1_OE_SEL0
POT__PRTDSI__OE_SEL1 EQU CYREG_PRT1_OE_SEL1
POT__PRTDSI__OUT_SEL0 EQU CYREG_PRT1_OUT_SEL0
POT__PRTDSI__OUT_SEL1 EQU CYREG_PRT1_OUT_SEL1
POT__PRTDSI__SYNC_OUT EQU CYREG_PRT1_SYNC_OUT
POT__PS EQU CYREG_PRT1_PS
POT__SLW EQU CYREG_PRT1_SLW

; Miscellaneous
; -- WARNING: define names containting LEOPARD or PANTHER are deprecated and will be removed in a future release
CYDEV_BOOTLOADER_IO_COMP_CUSTOM_IO EQU 0
CYDEV_DEBUGGING_DPS_SWD EQU 2
CYDEV_CONFIG_UNUSED_IO_AllowButWarn EQU 0
CYDEV_CONFIGURATION_MODE_DMA EQU 2
CYDEV_CONFIG_FASTBOOT_ENABLED EQU 1
CYDEV_CHIP_REV_LEOPARD_ES2 EQU 1
CYDEV_CHIP_REVISION_3A_ES2 EQU 1
CYDEV_CHIP_MEMBER_3A EQU 1
CYDEV_CHIP_FAMILY_PSOC3 EQU 1
CYDEV_CHIP_DIE_LEOPARD EQU 1
CYDEV_CHIP_DIE_EXPECT EQU CYDEV_CHIP_DIE_LEOPARD
CYDEV_BOOTLOADER_CHECKSUM_BASIC EQU 0
BCLK__BUS_CLK__HZ EQU 24000000
BCLK__BUS_CLK__KHZ EQU 24000
BCLK__BUS_CLK__MHZ EQU 24
CYDEV_APPLICATION_ID EQU 0x0000
CYDEV_APPLICATION_VERSION EQU 0x0000
CYDEV_BOOTLOADER_CHECKSUM EQU CYDEV_BOOTLOADER_CHECKSUM_BASIC
CYDEV_BOOTLOADER_CHECKSUM_CRC EQU 1
CYDEV_BOOTLOADER_FAST_VERIFY EQU 0
CYDEV_BOOTLOADER_VERSION EQU 0x0000
CYDEV_BOOTLOADER_WAIT_COMMAND EQU 1
CYDEV_BOOTLOADER_WAIT_TIME EQU 200
CYDEV_CHIP_DIE_ACTUAL EQU CYDEV_CHIP_DIE_EXPECT
CYDEV_CHIP_DIE_PANTHER EQU 2
CYDEV_CHIP_DIE_UNKNOWN EQU 0
CYDEV_CHIP_FAMILY_PSOC4 EQU 2
CYDEV_CHIP_FAMILY_PSOC5 EQU 3
CYDEV_CHIP_FAMILY_UNKNOWN EQU 0
CYDEV_CHIP_FAMILY_USED EQU CYDEV_CHIP_FAMILY_PSOC3
CYDEV_CHIP_JTAG_ID EQU 0x0E028069
CYDEV_CHIP_MEMBER_5A EQU 2
CYDEV_CHIP_MEMBER_UNKNOWN EQU 0
CYDEV_CHIP_MEMBER_USED EQU CYDEV_CHIP_MEMBER_3A
CYDEV_CHIP_REVISION_3A_ES1 EQU 0
CYDEV_CHIP_REVISION_3A_ES3 EQU 3
CYDEV_CHIP_REVISION_3A_PRODUCTION EQU 3
CYDEV_CHIP_REVISION_5A_ES0 EQU 0
CYDEV_CHIP_REVISION_5A_ES1 EQU 1
CYDEV_CHIP_REVISION_5A_PRODUCTION EQU 1
CYDEV_CHIP_REVISION_USED EQU CYDEV_CHIP_REVISION_3A_ES2
CYDEV_CHIP_REV_EXPECT EQU CYDEV_CHIP_REV_LEOPARD_ES2
CYDEV_CHIP_REV_LEOPARD_ES1 EQU 0
CYDEV_CHIP_REV_LEOPARD_ES3 EQU 3
CYDEV_CHIP_REV_LEOPARD_PRODUCTION EQU 3
CYDEV_CHIP_REV_PANTHER_ES0 EQU 0
CYDEV_CHIP_REV_PANTHER_ES1 EQU 1
CYDEV_CHIP_REV_PANTHER_PRODUCTION EQU 1
CYDEV_CONFIGURATION_CLEAR_SRAM EQU 1
CYDEV_CONFIGURATION_COMPRESSED EQU 0
CYDEV_CONFIGURATION_DMA EQU 1
CYDEV_CONFIGURATION_ECC EQU 1
CYDEV_CONFIGURATION_IMOENABLED EQU CYDEV_CONFIG_FASTBOOT_ENABLED
CYDEV_CONFIGURATION_MODE EQU CYDEV_CONFIGURATION_MODE_DMA
CYDEV_CONFIGURATION_MODE_COMPRESSED EQU 0
CYDEV_CONFIGURATION_MODE_UNCOMPRESSED EQU 1
CYDEV_CONFIG_FORCE_ROUTE EQU 0
CYDEV_CONFIG_UNUSED_IO EQU CYDEV_CONFIG_UNUSED_IO_AllowButWarn
CYDEV_CONFIG_UNUSED_IO_AllowWithInfo EQU 1
CYDEV_CONFIG_UNUSED_IO_Disallowed EQU 2
CYDEV_CUSTOM_ID EQU 0x00000000
CYDEV_DEBUGGING_DPS EQU CYDEV_DEBUGGING_DPS_SWD
CYDEV_DEBUGGING_DPS_Disable EQU 3
CYDEV_DEBUGGING_DPS_JTAG_4 EQU 1
CYDEV_DEBUGGING_DPS_JTAG_5 EQU 0
CYDEV_DEBUGGING_ENABLE EQU 1
CYDEV_DEBUGGING_REQXRES EQU 1
CYDEV_DEBUGGING_XRES EQU 0
CYDEV_DEBUG_ENABLE_MASK EQU 0x01
CYDEV_DEBUG_ENABLE_REGISTER EQU CYREG_MLOGIC_DBG_EN_DBG_EN
CYDEV_DMA_CHANNELS_AVAILABLE EQU 24
CYDEV_ECC_ENABLE EQU 0
CYDEV_INSTRUCT_CACHE_ENABLED EQU 0
CYDEV_PROJ_TYPE EQU 0
CYDEV_PROJ_TYPE_BOOTLOADER EQU 1
CYDEV_PROJ_TYPE_LOADABLE EQU 2
CYDEV_PROJ_TYPE_MULTIAPPBOOTLOADER EQU 3
CYDEV_PROJ_TYPE_STANDARD EQU 0
CYDEV_PROTECTION_ENABLE EQU 0
CYDEV_VDDA LIT '5.0'
CYDEV_VDDA_MV EQU 5000
CYDEV_VDDD LIT '5.0'
CYDEV_VDDD_MV EQU 5000
CYDEV_VDDIO0 LIT '5.0'
CYDEV_VDDIO0_MV EQU 5000
CYDEV_VDDIO1 LIT '5.0'
CYDEV_VDDIO1_MV EQU 5000
CYDEV_VDDIO2 LIT '5.0'
CYDEV_VDDIO2_MV EQU 5000
CYDEV_VDDIO3 LIT '5.0'
CYDEV_VDDIO3_MV EQU 5000
CYDEV_VIO0 EQU 5
CYDEV_VIO0_MV EQU 5000
CYDEV_VIO1 EQU 5
CYDEV_VIO1_MV EQU 5000
CYDEV_VIO2 EQU 5
CYDEV_VIO2_MV EQU 5000
CYDEV_VIO3 EQU 5
CYDEV_VIO3_MV EQU 5000
CyBtldr_Custom_Interface EQU CYDEV_BOOTLOADER_IO_COMP_CUSTOM_IO
DMA_CHANNELS_USED__MASK0 EQU 0x00000000
CYDEV_BOOTLOADER_ENABLE EQU 0

#endif /* INCLUDED_CYFITTERKEIL_INC */
